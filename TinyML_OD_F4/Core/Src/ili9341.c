#include "ili9341.h"
#include "spi.h"


extern SPI_HandleTypeDef hspi1;

static const uint8_t font5x7[][5] = {
    {0x00, 0x00, 0x00, 0x00, 0x00}, // Index 0: (Space)
    {0x7E, 0x09, 0x09, 0x09, 0x7E}, // 1: A
    {0x7F, 0x49, 0x49, 0x49, 0x36}, // 2: B
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    {0x20, 0x10, 0x08, 0x04, 0x02}  // 67: /
		
};

static uint8_t get_char_index(char c) {
    if(c >= 'A' && c <= 'Z') return c - 'A' + 1;
    if(c >= 'a' && c <= 'z') return c - 'a' + 27;
    if(c >= '0' && c <= '9') return c - '0' + 55;
    
    switch(c) {
        case ' ': return 0;
        case '!': return 53;
        case '=': return 54;
        case ':': return 65;
        case '%': return 66;
        case '/': return 67;
        default:  return 0;
    }
}

static void WriteCmd(uint8_t cmd) {
    HAL_GPIO_WritePin(GPIOA, GPIO_PIN_6, GPIO_PIN_RESET); // DC = Command
    HAL_GPIO_WritePin(GPIOA, GPIO_PIN_4, GPIO_PIN_RESET); // CS = Low
    HAL_SPI_Transmit(&hspi1, &cmd, 1, 10);
    HAL_GPIO_WritePin(GPIOA, GPIO_PIN_4, GPIO_PIN_SET);
}

static void WriteData(uint8_t data) {
    HAL_GPIO_WritePin(GPIOA, GPIO_PIN_6, GPIO_PIN_SET); // DC = Data
    HAL_GPIO_WritePin(GPIOA, GPIO_PIN_4, GPIO_PIN_RESET);
    HAL_SPI_Transmit(&hspi1, &data, 1, 10);
    HAL_GPIO_WritePin(GPIOA, GPIO_PIN_4, GPIO_PIN_SET);
}

void ILI9341_Init(void) {
    HAL_GPIO_WritePin(GPIOA, GPIO_PIN_8, GPIO_PIN_RESET); // RST = Low
    HAL_Delay(50);
    HAL_GPIO_WritePin(GPIOA, GPIO_PIN_8, GPIO_PIN_SET);   // RST = High
    HAL_Delay(50);

    WriteCmd(0x01); // Software Reset
    HAL_Delay(100);

    WriteCmd(0xC0); WriteData(0x23);
    WriteCmd(0xC1); WriteData(0x10);
    WriteCmd(0xC5); WriteData(0x3E); WriteData(0x28);
    WriteCmd(0xC7); WriteData(0x86);

    WriteCmd(0x36); WriteData(0x48);

    WriteCmd(0x3A); WriteData(0x55);

    WriteCmd(0x11); // Sleep Out
    HAL_Delay(100);
    WriteCmd(0x29); // Display On
    HAL_Delay(100);
}

void ILI9341_DrawPixel(uint16_t x, uint16_t y, uint16_t color) {
    WriteCmd(0x2A); 
    WriteData(x >> 8); WriteData(x & 0xFF); WriteData(x >> 8); WriteData(x & 0xFF);
    
    WriteCmd(0x2B); 
    WriteData(y >> 8); WriteData(y & 0xFF); WriteData(y >> 8); WriteData(y & 0xFF);
    
    WriteCmd(0x2C); 
    uint8_t c[2] = {color >> 8, color & 0xFF};
    HAL_GPIO_WritePin(GPIOA, GPIO_PIN_6, GPIO_PIN_SET);
    HAL_GPIO_WritePin(GPIOA, GPIO_PIN_4, GPIO_PIN_RESET);
    HAL_SPI_Transmit(&hspi1, c, 2, 10);
    HAL_GPIO_WritePin(GPIOA, GPIO_PIN_4, GPIO_PIN_SET);
}

void ILI9341_FillScreen(uint16_t color) {
    for(uint16_t y=0; y<320; y++) {
        for(uint16_t x=0; x<240; x++) {
            ILI9341_DrawPixel(x, y, color);
        }
    }
}

void ILI9341_DrawChar(uint16_t x, uint16_t y, char c, uint16_t color, uint16_t bg) {
    uint8_t idx = get_char_index(c);
    for(int i=0; i<5; i++) {
        uint8_t line = font5x7[idx][i];
        for(int j=0; j<8; j++) {
            uint16_t pColor = (line & 0x01) ? color : bg;
            ILI9341_DrawPixel(x + i*2, y + j*2, pColor);
            ILI9341_DrawPixel(x + i*2 + 1, y + j*2, pColor);
            ILI9341_DrawPixel(x + i*2, y + j*2 + 1, pColor);
            ILI9341_DrawPixel(x + i*2 + 1, y + j*2 + 1, pColor);
            line >>= 1;
        }
    }
}

void ILI9341_WriteString(uint16_t x, uint16_t y, const char* str, uint16_t color, uint16_t bg) {
    while(*str) {
        ILI9341_DrawChar(x, y, *str, color, bg);
        x += 12;
        str++;
    }
}